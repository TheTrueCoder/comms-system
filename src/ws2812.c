#include "ws2812.h"

#include "driver/rmt_encoder.h"
#include "driver/rmt_tx.h"
#include "esp_check.h"
#include "esp_rom_sys.h"
#include "freertos/FreeRTOS.h"
#include "freertos/task.h"

#include "app_config.h"

static const char *TAG = "ws2812";

/* 10 MHz -> 0.1 us per tick. WS2812: T0H=0.3us, T0L=0.9us, T1H=0.9us,
 * T1L=0.3us. The reset/latch gap is generated by leaving the line idle. */
#define WS2812_RESOLUTION_HZ (10 * 1000 * 1000)
#define WS2812_T0H_TICKS 3
#define WS2812_T0L_TICKS 9
#define WS2812_T1H_TICKS 9
#define WS2812_T1L_TICKS 3
#define WS2812_RESET_US 300

static rmt_channel_handle_t s_channel;
static rmt_encoder_handle_t s_encoder;
static bool s_initialized;

static uint8_t scale_brightness(uint8_t value)
{
    uint32_t percent = APP_LED_BRIGHTNESS;
    if (percent > 100) {
        percent = 100;
    }
    return (uint8_t)(((uint32_t)value * percent) / 100U);
}

static esp_err_t write_grb(uint8_t red, uint8_t green, uint8_t blue)
{
    if (!s_initialized) {
        return ESP_ERR_INVALID_STATE;
    }

    /* WS2812 expects green, red, blue, most-significant bit first. */
    const uint8_t grb[3] = {
        scale_brightness(green),
        scale_brightness(red),
        scale_brightness(blue),
    };

    const rmt_transmit_config_t tx_config = {
        .loop_count = 0,
        .flags.eot_level = 0,
    };

    esp_err_t err = rmt_transmit(s_channel, s_encoder, grb, sizeof(grb), &tx_config);
    if (err != ESP_OK) {
        return err;
    }

    /* Wait for the 24 bits to leave the peripheral before the stack buffer
     * goes out of scope, then hold the line low long enough to latch. */
    err = rmt_tx_wait_all_done(s_channel, 100);
    if (err != ESP_OK) {
        return err;
    }
    esp_rom_delay_us(WS2812_RESET_US);
    return ESP_OK;
}

esp_err_t led_init(gpio_num_t gpio)
{
    const rmt_tx_channel_config_t channel_config = {
        .gpio_num = gpio,
        .clk_src = RMT_CLK_SRC_DEFAULT,
        .resolution_hz = WS2812_RESOLUTION_HZ,
        .mem_block_symbols = 48,
        .trans_queue_depth = 4,
    };

    ESP_RETURN_ON_ERROR(rmt_new_tx_channel(&channel_config, &s_channel), TAG,
                        "create RMT TX channel");

    const rmt_bytes_encoder_config_t encoder_config = {
        .bit0 = {
            .level0 = 1,
            .duration0 = WS2812_T0H_TICKS,
            .level1 = 0,
            .duration1 = WS2812_T0L_TICKS,
        },
        .bit1 = {
            .level0 = 1,
            .duration0 = WS2812_T1H_TICKS,
            .level1 = 0,
            .duration1 = WS2812_T1L_TICKS,
        },
        .flags.msb_first = true,
    };

    ESP_RETURN_ON_ERROR(rmt_new_bytes_encoder(&encoder_config, &s_encoder), TAG,
                        "create bytes encoder");
    ESP_RETURN_ON_ERROR(rmt_enable(s_channel), TAG, "enable RMT channel");

    s_initialized = true;
    return write_grb(0, 0, 0);
}

esp_err_t led_set_rgb(uint8_t red, uint8_t green, uint8_t blue)
{
    return write_grb(red, green, blue);
}

esp_err_t led_set_active(bool active)
{
    if (!active) {
        return write_grb(0, 0, 0);
    }
    return write_grb(APP_LED_ACTIVE_R, APP_LED_ACTIVE_G, APP_LED_ACTIVE_B);
}

void led_self_test(void)
{
    if (!s_initialized) {
        return;
    }

    (void)led_set_rgb(255, 0, 0);
    vTaskDelay(pdMS_TO_TICKS(150));
    (void)led_set_rgb(0, 255, 0);
    vTaskDelay(pdMS_TO_TICKS(150));
    (void)led_set_rgb(0, 0, 255);
    vTaskDelay(pdMS_TO_TICKS(150));
    (void)led_set_rgb(0, 0, 0);
}
